## packages/jumpstarter-driver-flashers/oci_bundles/rcar_s4/flasher.its
```
/dts-v1/;

/ {
	description = "R-Car S4 flasher FIT Image";
	#address-cells = <1>;

	images {
		kernel {
			description = "Kernel";
			data = /incbin/("kernel/vmlinuz");
			type = "kernel";
			arch = "arm64";
			os = "linux";
			compression = "none";
			load = <0x48080000>;
			entry = <0x48080000>;
			hash {
				algo = "sha1";
			};
		};
		fdt {
			description = "DTB";
			data = /incbin/("kernel/dtb/renesas/r8a779f0-spider.dtb");
			type = "flat_dt";
			arch = "arm64";
			compression = "none";
			load = <0x48000000>;
			entry = <0x48000000>;
			hash {
				algo = "sha1";
			};
		};
		initrd {
			description = "Initrd";
			data = /incbin/("/buildroot/output/images/rootfs.cpio.lzo");
			type = "ramdisk";
			arch = "arm64";
			os = "linux";
			hash {
				algo = "sha1";
			};
		};
	};

	configurations {
		default = "standard";
		standard {
			description = "Standard Boot";
			kernel = "kernel";
			fdt = "fdt";
			ramdisk = "initrd";
			hash {
				algo = "sha1";
			};
		};
	};
};
```

## packages/jumpstarter-driver-flashers/oci_bundles/rcar_s4/renesas_s4_defconfig
```kconfig
BR2_aarch64=y
BR2_TOOLCHAIN_EXTERNAL=y
BR2_TARGET_GENERIC_HOSTNAME="flasher"
BR2_TARGET_GENERIC_ISSUE="flasher"
BR2_ROOTFS_DEVICE_CREATION_DYNAMIC_EUDEV=y
BR2_TARGET_GENERIC_ROOT_PASSWD=""
BR2_SYSTEM_DHCP="tsn0"
BR2_ROOTFS_OVERLAY="$(CONFIG_DIR)/overlay"
BR2_PACKAGE_CA_CERTIFICATES=y
BR2_PACKAGE_OPENSSL=y
BR2_PACKAGE_LIBCURL=y
BR2_PACKAGE_LIBCURL_CURL=y
BR2_PACKAGE_NTP=y
BR2_PACKAGE_NTP_SNTP=y
BR2_PACKAGE_NTP_NTPDATE=y
BR2_TARGET_ROOTFS_CPIO=y
BR2_TARGET_ROOTFS_CPIO_LZO=y
BR2_PACKAGE_DROPBEAR=n
# BR2_TARGET_ROOTFS_TAR is not set
```

## python/packages/jumpstarter-driver-flashers/oci_bundles/aarch64-itb/automotive.its
```
/dts-v1/;

/ {
	description = "kernel-automotive flasher FIT Image";
	#address-cells = <1>;

	images {
		kernel {
			description = "kernel-automotive";
			data = /incbin/("./kernel-automotive/vmlinuz");
			type = "kernel";
			arch = "arm64";
			os = "linux";
			compression = "none";
			load = <0x48080000>;
			entry = <0x48080000>;
			hash {
				algo = "sha256";
			};
		};
		fdt-spider {
			description = "DTB Renesas 8779f0-spider";
			data = /incbin/("./kernel-automotive/dtb/renesas/r8a779f0-spider.dtb");
			type = "flat_dt";
			arch = "arm64";
			compression = "none";
			load = <0x48000000>;
			entry = <0x48000000>;
			hash {
				algo = "sha256";
			};
		};
		fdt-s4sk {
			description = "DTB Renesas r8a779f4-s4sk";
			data = /incbin/("./kernel-automotive/dtb/renesas/r8a779f4-s4sk.dtb");
			type = "flat_dt";
			arch = "arm64";
			compression = "none";
			load = <0x48000000>;
			entry = <0x48000000>;
			hash {
				algo = "sha256";
			};
		};
		initrd {
			description = "Initrd";
			data = /incbin/("/var/tmp/buildroot/output/images/rootfs.cpio.lzo");
			type = "ramdisk";
			arch = "arm64";
			os = "linux";
			hash {
				algo = "sha256";
			};
		};
	};

	configurations {
		default = "spider";
		spider {
			description = "Boot Renesas R-Car S4 Spider";
			kernel = "kernel";
			fdt = "fdt-spider";
			ramdisk = "initrd";
			hash {
				algo = "sha256";
			};
		};
		s4sk {
			description = "Boot Renesas R-Car S4 SK";
			kernel = "kernel";
			fdt = "fdt-s4sk";
			ramdisk = "initrd";
			hash {
				algo = "sha256";
			};
		};
	};
};
```

## python/packages/jumpstarter-driver-flashers/oci_bundles/aarch64-itb/buildroot.its
```
/dts-v1/;

/ {
	description = "buildroot kernel flasher FIT Image";
	#address-cells = <1>;

	images {
		kernel {
			description = "buildroot Kernel";
			data = /incbin/("/var/tmp/buildroot/output/images/Image");
			type = "kernel";
			arch = "arm64";
			os = "linux";
			compression = "none";
			load = <0x80000000>;
			entry = <0x80000000>;
			hash {
				algo = "sha256";
			};
		};
		initrd {
			description = "Initrd";
			data = /incbin/("/var/tmp/buildroot/output/images/rootfs.cpio.lzo");
			type = "ramdisk";
			arch = "arm64";
			os = "linux";
			compression = "none";
			hash {
				algo = "sha256";
			};
		};
		fdt-j784s4 {
			description = "DTB TI J784S4EVM";
			data = /incbin/("/var/tmp/buildroot/output/images/k3-j784s4-evm.dtb");
			type = "flat_dt";
			arch = "arm64";
			compression = "none";
			load = <0x88000000>;
			hash {
				algo = "sha256";
			};
		};
		fdt-am69 {
			description = "DTB TI SK-AM69";
			data = /incbin/("/var/tmp/buildroot/output/images/k3-am69-sk.dtb");
			type = "flat_dt";
			arch = "arm64";
			compression = "none";
			load = <0x88000000>;
			hash {
				algo = "sha256";
			};
		};
	};

	configurations {
		default = "j784s4";
		j784s4 {
			description = "Boot TI J784S4EVM";
			kernel = "kernel";
			fdt = "fdt-j784s4";
			ramdisk = "initrd";
			hash {
				algo = "sha256";
			};
		};
		am69 {
			description = "Boot TI SK-AM69";
			kernel = "kernel";
			fdt = "fdt-am69";
			ramdisk = "initrd";
			hash {
				algo = "sha256";
			};
		};
	};
};
```

## python/packages/jumpstarter-driver-flashers/oci_bundles/aarch64-itb/buildroot_defconfig
```kconfig
# Initrd config
BR2_aarch64=y
BR2_TOOLCHAIN_EXTERNAL=y
BR2_TARGET_GENERIC_HOSTNAME="flasher"
BR2_TARGET_GENERIC_ISSUE="flasher"
BR2_ROOTFS_DEVICE_CREATION_DYNAMIC_EUDEV=y
BR2_TARGET_GENERIC_ROOT_PASSWD=""
BR2_SYSTEM_DHCP="eth0"
BR2_ROOTFS_OVERLAY="$(CONFIG_DIR)/overlay"
BR2_PACKAGE_CA_CERTIFICATES=y
BR2_PACKAGE_OPENSSL=y
BR2_PACKAGE_LIBCURL=y
BR2_PACKAGE_LIBCURL_CURL=y
BR2_PACKAGE_NTP=y
BR2_PACKAGE_NTP_SNTP=y
BR2_PACKAGE_NTP_NTPDATE=y
BR2_TARGET_ROOTFS_CPIO=y
BR2_TARGET_ROOTFS_CPIO_LZO=y
BR2_PACKAGE_DROPBEAR=n
# use full-featured dd
BR2_PACKAGE_BUSYBOX_SHOW_OTHERS=y
BR2_PACKAGE_COREUTILS=y
# BR2_TARGET_ROOTFS_TAR is not set
#
#
# Buildroot Kernel config
# include initramfs within the kernel Image
# on J784S4 the size exceeds uboot's CONFIG_SYS_BOOTM_LEN
# BR2_TARGET_ROOTFS_INITRAMFS=y
BR2_LINUX_KERNEL=y
BR2_LINUX_KERNEL_USE_ARCH_DEFAULT_CONFIG=y
BR2_LINUX_KERNEL_LZO=y
BR2_LINUX_KERNEL_IMAGE=y
BR2_LINUX_KERNEL_DTS_SUPPORT=y
BR2_LINUX_KERNEL_INTREE_DTS_NAME="ti/k3-j784s4-evm ti/k3-am69-sk"
```

## python/packages/jumpstarter-driver-flashers/oci_bundles/aarch64-itb/fedora.its
```
/dts-v1/;

/ {
	description = "buildroot kernel flasher FIT Image";
	#address-cells = <1>;

	images {
		kernel {
			description = "buildroot Kernel";
			data = /incbin/("./kernel-fedora/vmlinuz.lz4");
			type = "kernel";
			arch = "arm64";
			os = "linux";
			compression = "lz4";
			load = <0x80000000>;
			entry = <0x80000000>;
			hash {
				algo = "sha256";
			};
		};
		initrd {
			description = "Initrd";
			data = /incbin/("/var/tmp/buildroot/output/images/rootfs.cpio.lz4");
			type = "ramdisk";
			arch = "arm64";
			os = "linux";
			compression = "none";
			hash {
				algo = "sha256";
			};
		};
		fdt-j784s4 {
			description = "DTB TI J784S4EVM";
			data = /incbin/("./kernel-fedora/dtb/ti/k3-j784s4-evm.dtb");
			type = "flat_dt";
			arch = "arm64";
			compression = "none";
			load = <0x88000000>;
			hash {
				algo = "sha256";
			};
		};
		fdt-am69 {
			description = "DTB TI SK-AM69";
			data = /incbin/("./kernel-fedora/dtb/ti/k3-am69-sk.dtb");
			type = "flat_dt";
			arch = "arm64";
			compression = "none";
			load = <0x88000000>;
			hash {
				algo = "sha256";
			};
		};
		fdt-s32g3 {
			description = "DTB NXP S32G-VNP-RDB3";
			data = /incbin/("./s32g3.dtb");
			type = "flat_dt";
			arch = "arm64";
			compression = "none";
			load = <0x88000000>;
			hash {
				algo = "sha256";
			};
		};
	};

	configurations {
		default = "j784s4";
		j784s4 {
			description = "Boot TI J784S4EVM";
			kernel = "kernel";
			fdt = "fdt-j784s4";
			ramdisk = "initrd";
			hash {
				algo = "sha256";
			};
		};
		am69 {
			description = "Boot TI SK-AM69";
			kernel = "kernel";
			fdt = "fdt-am69";
			ramdisk = "initrd";
			hash {
				algo = "sha256";
			};
		};
		s32g3 {
			description = "Boot NXP S32G-VNP-RDB3";
			kernel = "kernel";
			fdt = "fdt-s32g3";
			ramdisk = "initrd";
			hash {
				algo = "sha256";
			};
		};
	};
};
```

## python/packages/jumpstarter-driver-flashers/oci_bundles/rcar_s4/flasher.its
```
/dts-v1/;

/ {
	description = "R-Car S4 flasher FIT Image";
	#address-cells = <1>;

	images {
		kernel {
			description = "Kernel";
			data = /incbin/("kernel/vmlinuz");
			type = "kernel";
			arch = "arm64";
			os = "linux";
			compression = "none";
			load = <0x48080000>;
			entry = <0x48080000>;
			hash {
				algo = "sha256";
			};
		};
		fdt-spider {
			description = "DTB 8779f0-spider";
			data = /incbin/("kernel/dtb/renesas/r8a779f0-spider.dtb");
			type = "flat_dt";
			arch = "arm64";
			compression = "none";
			load = <0x48000000>;
			entry = <0x48000000>;
			hash {
				algo = "sha256";
			};
		};
		fdt-s4sk {
			description = "DTB r8a779f4-s4sk";
			data = /incbin/("kernel/dtb/renesas/r8a779f4-s4sk.dtb");
			type = "flat_dt";
			arch = "arm64";
			compression = "none";
			load = <0x48000000>;
			entry = <0x48000000>;
			hash {
				algo = "sha256";
			};
		};
		initrd {
			description = "Initrd";
			data = /incbin/("/buildroot/output/images/rootfs.cpio.lzo");
			type = "ramdisk";
			arch = "arm64";
			os = "linux";
			hash {
				algo = "sha256";
			};
		};
	};

	configurations {
		default = "spider";
		spider {
			description = "Boot R-Car S4 Spider";
			kernel = "kernel";
			fdt = "fdt-spider";
			ramdisk = "initrd";
			hash {
				algo = "sha256";
			};
		};
		s4sk {
			description = "Boot R-Car S4 SK";
			kernel = "kernel";
			fdt = "fdt-s4sk";
			ramdisk = "initrd";
			hash {
				algo = "sha256";
			};
		};
	};
};
```
